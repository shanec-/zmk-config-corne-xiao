#include "../miryoku/custom_config.h"
#include "../miryoku/mapping/42/corne-xiao.h"
#include "../miryoku/custom_miryoku.dtsi"

/ {
    combos {
        compatible = "zmk,combos";
        combo_studio_unlock {
            timeout-ms = <50>;
            key-positions = <0 1>;
            bindings = <&studio_unlock>;
        };
    };
};
